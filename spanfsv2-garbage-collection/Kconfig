## spanfsv2-garbage-collection/Kconfig
```kconfig
config SPANFSV2_FS
	tristate "The spanfsv2 filesystem"
	select JBD2
	select CRC16
	select CRYPTO
	select CRYPTO_CRC32C

config SPANFSV2_USE_FOR_EXT23
	bool "Use spanfsv2 for ext2/ext3 file systems"
	depends on SPANFSV2_FS
	depends on EXT3_FS=n || EXT2_FS=n
	default y

config SPANFSV2_FS_POSIX_ACL
	bool "Spanfsv2 POSIX Access Control Lists"
	depends on SPANFSV2_FS
	select FS_POSIX_ACL
config SPANFSV2_FS_SECURITY
	bool "Spanfsv2 Security Labels"
	depends on SPANFSV2_FS
config SPANFSV2_DEBUG
	bool "Spanfsv2 debugging support"
	depends on SPANFSV2_FS
```
